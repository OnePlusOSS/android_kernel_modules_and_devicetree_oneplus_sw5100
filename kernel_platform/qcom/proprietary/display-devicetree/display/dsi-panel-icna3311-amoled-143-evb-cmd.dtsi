&mdss_mdp {
	dsi_tm_icna3311_amoled_143_evb_cmd: qcom,mdss_dsi_icna3311_amoled_143_evb_cmd {
		qcom,mdss-dsi-panel-name =
			"ICNA3311 1.43 amoled cmd mode";
		qcom,mdss-dsi-panel-type = "dsi_cmd_mode";
		qcom,mdss-dsi-panel-physical-type = "oled";
		qcom,mdss-dsi-virtual-channel-id = <0>;
		qcom,mdss-dsi-stream = <0>;
		qcom,mdss-dsi-bpp = <24>;
		qcom,mdss-dsi-color-order = "rgb_swap_rgb";
		qcom,mdss-dsi-underflow-color = <0xff>;
		qcom,mdss-dsi-border-color = <0>;

		qcom,dsi-ctrl-num = <0>;
		qcom,dsi-phy-num = <0>;

		qcom,mdss-dsi-traffic-mode = "burst_mode";
		qcom,mdss-dsi-lane-map = "lane_map_0123";
		qcom,mdss-dsi-bllp-eof-power-mode;
		qcom,mdss-dsi-bllp-power-mode;
		qcom,mdss-dsi-lane-0-state;
		qcom,mdss-dsi-dma-trigger = "trigger_sw";
		qcom,mdss-dsi-mdp-trigger = "none";
		qcom,mdss-dsi-reset-sequence = <1 10>;
		qcom,mdss-dsi-te-pin-select = <1>;
		qcom,mdss-dsi-te-dcs-command = <1>;
		qcom,mdss-dsi-te-check-enable;
		qcom,mdss-dsi-te-using-te-pin;
		qcom,mdss-dsi-t-clk-post = <0x09>;
		qcom,mdss-dsi-t-clk-pre = <0x0D>;

		qcom,mdss-dsi-bl-pmic-control-type = "bl_ctrl_dcs";
		qcom,mdss-dsi-bl-min-level = <1>;
		qcom,mdss-dsi-bl-max-level = <255>;

		qcom,mdss-dsi-display-timings {
			timing@0 {
				qcom,mdss-dsi-panel-framerate = <60>;
				qcom,mdss-dsi-panel-width = <466>;
				qcom,mdss-dsi-panel-height = <466>;
				qcom,mdss-dsi-h-front-porch = <7>;
				qcom,mdss-dsi-h-back-porch = <7>;
				qcom,mdss-dsi-h-pulse-width = <2>;
				qcom,mdss-dsi-h-sync-skew = <0>;
				qcom,mdss-dsi-v-back-porch = <7>;
				qcom,mdss-dsi-v-front-porch = <7>;
				qcom,mdss-dsi-v-pulse-width = <2>;
				qcom,mdss-dsi-h-left-border = <0>;
				qcom,mdss-dsi-h-right-border = <0>;
				qcom,mdss-dsi-v-top-border = <0>;
				qcom,mdss-dsi-v-bottom-border = <0>;

				qcom,mdss-dsi-on-command = [
					15 01 00 00 00 00 02 FE 20
					15 01 00 00 00 00 02 F4 5A
					15 01 00 00 00 00 02 F5 59    /*cmd2 enable*/
					15 01 00 00 00 00 02 FE 80
					15 01 00 00 00 00 02 92 06    /*dimming cfg*/
					15 01 00 00 00 00 02 FE D0
					15 01 00 00 00 00 02 21 53
					15 01 00 00 00 00 02 3A 07
					15 01 00 00 00 00 02 3B 14     /*TE output ESD detection Signal*/
					15 01 00 00 00 00 02 FE 40
					15 01 00 00 00 00 02 61 01
					15 01 00 00 00 00 02 62 E3    /*AOD 30hz*/
					15 01 00 00 00 00 02 FE 90
					15 01 00 00 00 00 02 4D 00
					15 01 00 00 00 00 02 FE 40
					15 01 00 00 00 00 02 0B 02     /*idle TE output Frame Rate*/
					15 01 00 00 00 00 02 FE 00
					15 01 00 00 00 00 02 35 00     /*set TE*/
					15 01 00 00 00 00 02 53 20
					15 01 00 00 00 00 02 63 FF
					39 01 00 00 00 00 05 2A 00 06 01 D7
					39 01 00 00 00 00 05 2B 00 00 01 D1
					05 01 00 00 3C 00 01 11        /*sleep out*/
					05 01 00 00 00 00 01 29        /*display on*/
				];
				qcom,mdss-dsi-off-command = [
					15 01 00 00 00 00 02 FE 00
					05 01 00 00 00 00 01 28     /*display off*/
					05 01 00 00 64 00 01 10     /*sleep in*/
				];
				qcom,mdss-dsi-on-command-state = "dsi_lp_mode";
				qcom,mdss-dsi-off-command-state = "dsi_hs_mode";

				qcom,mdss-dsi-lp1-command = [
					15 01 00 00 00 00 02 FE 00
					15 01 00 00 00 00 02 39 00  /*Idle Mode on*/
				];
				qcom,mdss-dsi-nolp-command = [
					15 01 00 00 00 00 02 FE 00
					15 01 00 00 00 00 02 38 00  /*Idle Mode Off*/
				];
				qcom,mdss-dsi-lp1-command-state = "dsi_lp_mode";
				qcom,mdss-dsi-nolp-command-state = "dsi_lp_mode";

				qcom,mdss-dsi-hbm-on-command = [
					15 01 00 00 00 00 02 FE 70
					15 01 00 00 00 00 02 66 05
					15 01 00 00 00 00 02 FE 00
					15 01 00 00 00 00 02 66 02  /*HBM enter*/
				];
				qcom,mdss-dsi-hbm-off-command = [
					15 01 00 00 00 00 02 FE 70
					15 01 00 00 00 00 02 66 47
					15 01 00 00 00 00 02 FE 00
					15 01 00 00 00 00 02 66 00  /*HBM exit*/
				];
				qcom,mdss-dsi-hbm-on-command-state = "dsi_lp_mode";
				qcom,mdss-dsi-hbm-off-command-state = "dsi_lp_mode";
				qcom,mdss-dsi-data-dimming-on-command = [
					15 01 00 00 00 00 02 FE 00
					15 01 00 00 00 00 02 53 28
				];
				qcom,mdss-dsi-data-dimming-off-command = [
					15 01 00 00 00 00 02 FE 00
					15 01 00 00 00 00 02 53 20
				];
				qcom,mdss-dsi-data-dimming-on-command-state = "dsi_lp_mode";
				qcom,mdss-dsi-data-dimming-off-command-state = "dsi_lp_mode";
				qcom,mdss-dsi-lock-command = [
					15 01 00 00 00 00 02 FE 80
					15 01 00 00 00 00 02 F4 AC
					15 01 00 00 00 00 02 F5 E1    /*cmd1 lock*/
				];
				qcom,mdss-dsi-unlock-command = [
					15 01 00 00 00 00 02 FE 80
					15 01 00 00 00 00 02 F4 00
					15 01 00 00 00 00 02 F5 00    /*cmd1 unlock*/
				];
				qcom,mdss-dsi-lock-command-state = "dsi_lp_mode";
				qcom,mdss-dsi-unlock-command-state = "dsi_lp_mode";
			};
		};
	};
};
