/dts-v1/;
/plugin/;

#include "monaco-nfc-common.dtsi"
/ {
	model = "Qualcomm Technologies, Inc. Monaco";
	compatible = "qcom,monaco", "qcom,idp";
	qcom,msm-id = <517 0x10000>;
	qcom,board-id = <0x010022 0x0>;
};
